

/dts-v1/;

/include/ "am335x-boneblack.dtsi"

&am33xx_pinmux {
	uart1_pins: pinmux_uart1_pins {
		pinctrl-single,pins = <
			0x184 0x20 /* P9.24 uart1_txd.uart1_txd  OUTPUT  */
			0x180 0x20 /* P9.26 uart1_rxd.uart1_rxd  INPUT  */
		>;
	};
};

/* Disable internal epprom */
&i2c0 {
	status = "disabled";
};

&uart2 {
	status = "okay";
	pinctrl-names = "default";
	pinctrl-0 = <&uart1_pins>;
};